// ConfigFile.cpp

/* ESParasite Data Logger
        Authors: Andy  (SolidSt8Dad)Eakin

        Please see /ATTRIB for full credits and OSS License Info
        Please see /LIBRARIES for necessary libraries
        Please see /VERSION for Hstory

        All Derived Content is subject to the most restrictive licence of it's
        source.

        All Original content is free and unencumbered software released into the
        public domain.

        The Author(s) are extremely grateful for the amazing open source
        communities that work to support all of the sensors, microcontrollers,
        web standards, etc.
*/

#include <ArduinoJson.h>
#include <FS.h>
#include <SPIFFS.h>

#include "API.h"
#include "DebugUtils.h"
#include "ESParaSite.h"

extern ESParaSite::configData config;

DynamicJsonDocument ESParaSite::APIHandler::getFSInfo(int8_t mode) {
  DynamicJsonDocument doc(256);
  if (mode == 1) {
    Serial.println("Filesystem Bytes: ");
    Serial.print("Total Filesystem Bytes:\t");
    Serial.println(SPIFFS.totalBytes());
    Serial.print("Used Filesystem Bytes:\t");
    Serial.println(SPIFFS.usedBytes());
    Serial.println();

    return doc;

  } else if (mode == 2) {
    doc["class"] = "fsInfo";
    doc["tFsB"] = SPIFFS.totalBytes();
    doc["uFsB"] = SPIFFS.usedBytes();

    return doc;
  } else {
    return doc;
  }
}

DynamicJsonDocument ESParaSite::APIHandler::getFSList(int8_t mode) {
  DynamicJsonDocument parentDoc(4096);
  DynamicJsonDocument nestedDoc(80);

  File root = SPIFFS.open("/", "r");
  File file = root.openNextFile();
  
  if (mode == 1) {
    Serial.println("File List: ");
    while (file) {
      Serial.print(file.name());
      Serial.print("\t\t");
      Serial.println(file.size());
      file = root.openNextFile();
    }
    Serial.println();
    return parentDoc;
  } else if (mode == 2) {
    // Due to the potential size of the data generated by listing the
    // directory structure we break it into 4kB chunks and send it to
    // the client.

    while (file) {

      for (int8_t i = 0; i < 40; i++) {

        JsonObject nested = nestedDoc.to<JsonObject>();

        String fName = file.name();
        nested["fName"] = fName;
        nested["fSize"] = file.size();

        String child;
        serializeJson(nestedDoc, child);
        parentDoc.add(serialized(child));

        file = root.openNextFile();
        if (!file) {
          break;
        }
      }
    }
    return parentDoc;
  } else {
    return parentDoc;
  }
}
